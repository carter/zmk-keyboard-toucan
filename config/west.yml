## config/west.yml
```yaml
manifest:
  defaults:
    revision: v0.3
  remotes:
    - name: zmkfirmware
      url-base: https://github.com/zmkfirmware
    - name: petejohanson
      url-base: https://github.com/petejohanson/
    - name: caksoylar
      url-base: https://github.com/caksoylar
    - name: geeksville
      url-base: https://github.com/geeksville
    - name: zzeneg
      url-base: https://github.com/zzeneg
    - name: srwi
      url-base: https://github.com/srwi
  projects:
    - name: zmk
      remote: zmkfirmware
      import: app/west.yml
    - name: cirque-input-module
      remote: geeksville
      revision: toucan
    - name: zmk-rgbled-widget
      remote: caksoylar
      revision: v0.3
    - name: zmk-raw-hid
      remote: zzeneg
      revision: main
    - name: zmk-keypeek-layer-notifier
      remote: srwi
      revision: master
  self:
    path: config
```
